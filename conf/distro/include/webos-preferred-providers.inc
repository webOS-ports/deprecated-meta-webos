## conf/distro/include/webos-preferred-providers.inc
```bitbake
# (c) Copyright 2012  Hewlett-Packard Development Company, L.P.

# Place distro-wide PREFERRED_PROVIDER settings here; place MACHINE-specific
# settings in <MACHINE>.conf .

# Prefer libjpeg-turbo from meta-oe
PREFERRED_PROVIDER_jpeg = "libjpeg-turbo"
PREFERRED_PROVIDER_jpeg-native = "libjpeg-turbo-native"
PREFERRED_PROVIDER_qmake-webos-native = "qt4-native"
```
